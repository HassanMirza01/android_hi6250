## Kconfig
```kconfig
#
# For a description of the syntax of this configuration file,
# see Documentation/kbuild/kconfig-language.txt.
#
mainmenu "Linux/$ARCH $KERNELVERSION Kernel Configuration"

config SRCARCH
	string
	option env="SRCARCH"

config SYSTEM_LINEAGEOS
	bool "build for LOS based ROMs"
	default n
	help
	  LineageOS needs a different configuration compared to
	  stock rom.

	  Say Y here if you want to build kernel for LineageOS rom.

	  If building for stock rom, say N here.

source "arch/$SRCARCH/Kconfig"
```

## arch/arm64/hotplug/Kconfig
```kconfig
config MAKO_HOTPLUG
 	bool "Mako Hotplug"
 	default n
 	help
 	  Mako Hotplug: A custom hotplug MOD by fransico franco

config ALUCARD_HOTPLUG
	bool "Enable alucard-hotplug cpu hotplug driver"
	default n
	help
	  Generic Alucard-hotplug cpu hotplug driver for ARM SOCs

config INTELLI_HOTPLUG
        bool "Enable intelli-plug cpu hotplug driver"
        default n
        help
          Generic Intelli-plug cpu hotplug driver for ARM SOCs

config THUNDERPLUG_CONTROL
	bool "Enable plugging down/up of cores based on load per core"
	default n
	help
	  This driver hotplugs cpu cores based on per-core load

config BLU_HOTPLUG
        default n

config INTELLI_HOTPLUG
        default n

config LAZY_HOTPLUG
        default n

config BRICKED_HOTPLUG
        default n

config FAST_HOTPLUG
        default n

config ZEN_DECISION
	bool "Zen Decision: MSM Userspace Handler"
	depends on SMP && FB
	default n
	help
	  MSM/Qcomm devices have multiple userspace applications that handle
	  CPU hotplugging and frequency operations.

	  ZenDecision is a "handler" to account for behavior caused by
	  disabling some of these services.

	  For example, If MPDecision is disabled and MSM-Thermal_Engine is 
	  enabled in the userspace. Situations where CPUs go offline but never
	  come back online occur. ZenDecision handles the situation of CPUs
	  never coming online when they are supposed.
  
	  ZenDecision ensures all CPUs are online when they are supposed to be by:
	  - Enable all CPUs when screen comes on after wake_wait_delay
	  - Ignore all CPU_UP operations when battery level is <= 15% to respect
	    decisions of MSMThermal.

	  Userspace tunables for ZenDecision (/sys/kernel/zen_decision):
	  - enabled (0 or 1): Enable or disable the driver.
	  - wake_wait_time (0-60000): How long to wait before executing CPU_UP work.
	  - bat_threshold_ignore (0-100, 0=disabled): Don't do any CPU_UP work up to
	     this battery charge level.

	  WARNING: ZenDecision is not a direct replacement for any of the MSM userspace
	  services. It is simply designed to "handle" specific behaviors that are caused
	  by disabling these services.

	  If unsure, say N.

config HIMA_HOTPLUG
	default n
```

## drivers/devkit/tpkit/Kconfig
```kconfig
#
# huawei touchscreen driver configuration
#

menuconfig HUAWEI_TS_KIT
	bool "huawei TS_KIT drivers"
	default n
	help
	  If you say yes here you get support for huawei touchscreen.
menuconfig HUAWEI_TS_KIT_TEST
	bool "huawei TS_KIT test"
	default n
	help
	  If you say yes here you get support for huawei touchscreen.

source "drivers/devkit/tpkit/panel/Kconfig"

#sensor unification for differ platform
menuconfig HUAWEI_TP_KIT_COLOR_INFO
	bool "huawei TS_KIT tp color info"
	default n
	help
		get the huawei TS_KIT tp color information.
```

## drivers/devkit/tpkit/panel/Kconfig
```kconfig
#
# huawei touchscreen driver configuration
#


source "drivers/devkit/tpkit/panel/focaltech/Kconfig"
source "drivers/devkit/tpkit/panel/synaptics/Kconfig"
source "drivers/devkit/tpkit/panel/parade/Kconfig"
source "drivers/devkit/tpkit/panel/novatek/Kconfig"
source "drivers/devkit/tpkit/panel/ilitek/Kconfig"
```

## drivers/devkit/tpkit/panel/focaltech/Kconfig
```kconfig
#
# huawei touchscreen driver configuration
#

menuconfig FOCAL_TS_KIT
	bool "TS_KIT focaltech drivers"
	default n
	help
	  If you say yes here you get support for huawei touchscreen.
```

## drivers/devkit/tpkit/panel/novatek/Kconfig
```kconfig
#
# huawei touchscreen driver configuration
#

menuconfig NOVATEK_TS_KIT
	bool "novatek ts kit drivers"
	default n
	help
	  If you say yes here you get support for huawei touchscreen.
```

## drivers/huawei_platform/lcd/Kconfig
```kconfig
#
# huawei lcd panel driver configuration
#

config HUAWEI_LCD_PANEL
	bool "huawei lcd panel"
	default n
	help
	  If you say yes here you get support for huawei lcd panel.

config HUAWEI_LCD_PANEL_DARKNESS_MOD
	bool "huawei lcd panel darkness mod"
	default n
	help
	  If you say yes here you get support for full spectrum of hardware
	  brightness levels (only supported panels, a.t.m. only
	  AUO_ILI9885 5.5' VIDEO TFT 1080 x 1920 is supported)
```

## drivers/huawei_platform/lcd_on_off_check/Kconfig
```kconfig
config LCD_ON_OFF_CHECK
        bool "huawei LCD_ON_OFF_CHECK"
        default n
        depends on HISI_POWERKEY
        help
          If you say yes here you get support for huawei POWER KEY on/off check.
```

## drivers/huawei_platform/power/charger/Kconfig
```kconfig
source "drivers/huawei_platform/power/charger/charger_ap/Kconfig"
source "drivers/huawei_platform/power/charger/charger_sensorhub/Kconfig"

config HUAWEI_CHARGER
	bool "huawei charger"
	default n

config ADVANCED_CHARGE_CONTROL
	bool "advanced charge control features"
	default n
```

## drivers/huawei_platform/usb/switch/switch_sensorhub/Kconfig
```kconfig
if SWITCH

# I2C SWITCH_CHIP driver configuration
config SWITCH_FSA9685_SENSORHUB
	tristate "SWITCH_FSA9685_SENSORHUB"
	depends on GPIOLIB && I2C
	help
	  If you say yes here you get support for SWITCH_FSA9685_SENSORHUB.
endif # SWITCH
```

## drivers/media/huawei/camera/Kconfig
```kconfig
comment "Huawei Camera"

# source "drivers/media/huawei/camera/isp/Kconfig"
source "drivers/media/huawei/camera/hisp/Kconfig"
source "drivers/media/huawei/camera/sensor/Kconfig"
source "drivers/media/huawei/camera/laser/Kconfig"

if HISI_CAMERA_HISTAR_ISPV160
source "drivers/media/huawei/camera/platform/kirin970/Kconfig"
endif

if HISI_CAMERA_HISTAR_ISPV150
source "drivers/media/huawei/camera/platform/hi3660/Kconfig"
endif

if HISI_CAMERA_HISTAR_ISPV100
source "drivers/media/huawei/camera/platform/hi3650/Kconfig"
endif

if HISI_CAMERA_OVISP23
source "drivers/media/huawei/camera/platform/hi3635/Kconfig"
endif

if HISI_CAMERA_HISTAR_ISPV110
source "drivers/media/huawei/camera/platform/hi6250/Kconfig"
endif

menuconfig HISI_CAMERA_LASER
    bool "Huawei laser support"
    default n
    help
        Say Y here to enable Laser for Huawei camera

menuconfig HISI_CAMERA_FLASH
    bool "Huawei flash support"
    default n
    help
        Say Y here to enable Flash for Huawei camera

menuconfig HUAWEI_CAMERA_USE_EXTISP
    bool "Huawei external ISP support"
    default n
    select SPI
    help
        Say Y here to enable external ISP for Huawei camera

config HISI_CAMERA_HISTAR_ISPV100
    tristate "Support histar ispv100 driver"
    depends on HUAWEI_CAMERA
    default n
    ---help---
        Hisilicon histar ispv100 driver.

config HISI_CAMERA_HISTAR_ISPV110
    tristate "Support histar ispv110 driver"
    depends on HUAWEI_CAMERA
    default n
    ---help---
        Hisilicon histar ispv110 driver.

config HISI_CAMERA_HISTAR_ISPV150
    tristate "Support histar ispv150 driver"
    depends on HUAWEI_CAMERA
    default n
    ---help---
        Hisilicon histar ispv150 driver.

config HISI_CAMERA_HISTAR_ISPV160
    tristate "Support histar ispv160 driver"
    depends on HUAWEI_CAMERA
    default n
    ---help---
        Hisilicon histar ispv160 driver.

config HISI_CAMERA_OVISP23
    tristate "Support ovisp23 driver"
    depends on HUAWEI_CAMERA
    default n
    ---help---
        Hisilicon ovisp23 driver.

if HUAWEI_CAMERA_USE_EXTISP
source "drivers/media/huawei/camera/extisp/Kconfig"
endif
```

## drivers/media/huawei/camera/platform/hi3660/Kconfig
```kconfig
comment "Huawei Sensor hi3660"

source "drivers/media/huawei/camera/sensor/vcm/Kconfig"
source "drivers/media/huawei/camera/sensor/flash/Kconfig"
source "drivers/media/huawei/camera/sensor/ois/Kconfig"

config HUAWEI_CAMERA_USE_IMX230
	bool "imx230"
    default y
	depends on HUAWEI_CAMERA

config HUAWEI_CAMERA_USE_IMX298
	bool "imx298"
    default y
	depends on HUAWEI_CAMERA

config HUAWEI_CAMERA_USE_IMX179
	bool "imx179"
    default y
	depends on HUAWEI_CAMERA

config HUAWEI_CAMERA_USE_IMX179_CMB
	bool "imx179_cmb"
    default n
	depends on HUAWEI_CAMERA

config HUAWEI_CAMERA_USE_IMX286DUAL
	bool "imx286dual"
    default y
	depends on HUAWEI_CAMERA

config HUAWEI_CAMERA_USE_IMX286DUAL_CMB
	bool "imx286dual_cmb"
    default n
	depends on HUAWEI_CAMERA

config HUAWEI_CAMERA_USE_IMX286DUAL_DUKE
	bool "imx286dual_duke"
    default n
	depends on HUAWEI_CAMERA

config HUAWEI_CAMERA_USE_OV8865
	bool "ov8865"
    default y
	depends on HUAWEI_CAMERA

config HUAWEI_CAMERA_USE_IMX286HYBIRD
	bool "imx286hybird"
    default y
	depends on HUAWEI_CAMERA

config HUAWEI_CAMERA_USE_IMX386HYBIRD
	bool "imx386hybird"
    default y
	depends on HUAWEI_CAMERA

config HUAWEI_CAMERA_USE_IMX219
	bool "imx219"
    default n
	depends on HUAWEI_CAMERA

config HUAWEI_CAMERA_USE_IMX219_VIC
	bool "imx219_vic"
    default y
	depends on HUAWEI_CAMERA

config HUAWEI_CAMERA_USE_IMX319
	bool "imx319"
    default y
	depends on HUAWEI_CAMERA

config HUAWEI_CAMERA_USE_IMX219_DUKE
	bool "imx219_duke"
    default n
	depends on HUAWEI_CAMERA

config HUAWEI_CAMERA_USE_IMX219_STF
	bool "imx219_stf"
    default n
	depends on HUAWEI_CAMERA

config HUAWEI_CAMERA_USE_HI843
	bool "hi843"
    default n
	depends on HUAWEI_CAMERA

config HUAWEI_CAMERA_USE_HI843_DUKE
	bool "hi843_duke"
    default n
	depends on HUAWEI_CAMERA

config HUAWEI_CAMERA_USE_HI843_STF
	bool "hi843_stf"
    default n
	depends on HUAWEI_CAMERA

config HUAWEI_CAMERA_USE_OV2281
	bool "ov2281"
    default y
	depends on HUAWEI_CAMERA

config HUAWEI_CAMERA_USE_IMX386HYBIRD_STF
	bool "imx386hybird_stf"
    default n
	depends on HUAWEI_CAMERA
```

## drivers/media/huawei/camera/platform/kirin970/Kconfig
```kconfig
comment "Huawei Sensor kirin970"

source "drivers/media/huawei/camera/sensor/vcm/Kconfig"
source "drivers/media/huawei/camera/sensor/flash/Kconfig"
source "drivers/media/huawei/camera/sensor/ois/Kconfig"

config HUAWEI_CAMERA_USE_IMX230
	bool "imx230"
    default y
	depends on HUAWEI_CAMERA

config HUAWEI_CAMERA_USE_IMX298
	bool "imx298"
    default y
	depends on HUAWEI_CAMERA

config HUAWEI_CAMERA_USE_IMX179
	bool "imx179"
    default y
	depends on HUAWEI_CAMERA


config HUAWEI_CAMERA_USE_IMX286DUAL
	bool "imx286dual"
    default y
	depends on HUAWEI_CAMERA


config HUAWEI_CAMERA_USE_OV8865
	bool "ov8865"
    default y
	depends on HUAWEI_CAMERA

config HUAWEI_CAMERA_USE_IMX286HYBIRD
	bool "imx286hybird"
    default y
	depends on HUAWEI_CAMERA

config HUAWEI_CAMERA_USE_IMX386HYBIRD
	bool "imx386hybird"
    default y
	depends on HUAWEI_CAMERA

config HUAWEI_CAMERA_USE_IMX219
	bool "imx219"
    default n
	depends on HUAWEI_CAMERA

config HUAWEI_CAMERA_USE_HI843
	bool "hi843"
    default n

config HUAWEI_CAMERA_USE_OV2281
	bool "ov2281"
    default y
	depends on HUAWEI_CAMERA
```
